## package/boot/uboot-taurus/files/arch/arm/mach-cortina/Kconfig
```kconfig
if ARCH_CORTINA

choice
	prompt "Cortina Access board select"
	default TARGET_VSOL_HG325AX30

config TARGET_VSOL_HG325AX30
	bool "VSOL HG325AX30 (Realtek RTL9607DQ)"
	select ARM64
	select BOARD_LATE_INIT
	help
	  Realtek RTL9607DQ "Taurus" GPON router, started by the vendor
	  U-Boot (chainload) or by BL31 as BL33. SoC, DRAM and clock set-up
	  is done by the earlier boot stages.

endchoice

config SYS_SOC
	default "cortina"

source "board/vsol/hg325ax30/Kconfig"

endif
```

## package/boot/uboot-taurus/files/board/vsol/hg325ax30/Kconfig
```kconfig
if TARGET_VSOL_HG325AX30

config SYS_BOARD
	default "hg325ax30"

config SYS_VENDOR
	default "vsol"

config SYS_CONFIG_NAME
	default "hg325ax30"

endif
```

## package/boot/uboot-taurus/files/configs/vsol_hg325ax30_defconfig
```kconfig
CONFIG_ARM=y
CONFIG_COUNTER_FREQUENCY=25000000
CONFIG_SYS_ARCH_TIMER=y
CONFIG_ARCH_CORTINA=y
CONFIG_TARGET_VSOL_HG325AX30=y
CONFIG_TEXT_BASE=0x06000000
CONFIG_SYS_MALLOC_LEN=0x820000
CONFIG_SYS_MALLOC_F_LEN=0x2000
CONFIG_NR_DRAM_BANKS=2
CONFIG_HAS_CUSTOM_SYS_INIT_SP_ADDR=y
CONFIG_CUSTOM_SYS_INIT_SP_ADDR=0x05f00000
CONFIG_DM_GPIO=y
CONFIG_DEFAULT_DEVICE_TREE="rtl9607dq-vsol-hg325ax30"
CONFIG_SYS_LOAD_ADDR=0x05000000
CONFIG_IDENT_STRING=" hg325ax30"
# CONFIG_LOCALVERSION_AUTO is not set
CONFIG_REMAKE_ELF=y
CONFIG_SUPPORT_RAW_INITRD=y
# CONFIG_BOOTSTD is not set
# CONFIG_EFI_LOADER is not set
# CONFIG_MMC is not set
CONFIG_BOOTDELAY=3
CONFIG_SYS_CBSIZE=256
CONFIG_SYS_PBSIZE=276
CONFIG_SYS_PROMPT="RTL9607DQ> "
CONFIG_CMD_MTD=y
CONFIG_CMD_WDT=y
CONFIG_CMD_CACHE=y
CONFIG_CMD_TIMER=y
CONFIG_CMD_SMC=y
# CONFIG_CMD_BOOTEFI is not set
# CONFIG_CMD_ELF is not set
# CONFIG_CMD_LOADB is not set
# CONFIG_CMD_LOADS is not set
# CONFIG_CMD_LZMADEC is not set
# CONFIG_CMD_UNZIP is not set
# CONFIG_CMD_UBIFS is not set
CONFIG_OF_CONTROL=y
CONFIG_DM_SERIAL=y
CONFIG_CORTINA_UART=y
CONFIG_SYSRESET=y
CONFIG_SYSRESET_PSCI=y
CONFIG_DM_SPI=y
CONFIG_SPI=y
CONFIG_CORTINA_QSPI=y
CONFIG_DM_MTD=y
CONFIG_MTD=y
CONFIG_MTD_SPI_NAND=y
CONFIG_MTD_PARTITIONS=y
CONFIG_MTD_UBI=y
CONFIG_CMD_UBI=y
CONFIG_CMD_CRC32=y
CONFIG_HUSH_PARSER=y
CONFIG_CMDLINE_NO_REPEAT=y
CONFIG_FIT=y
CONFIG_LZMA=y
CONFIG_CMD_IMI=y
CONFIG_SYS_BOOTM_LEN=0x4000000
CONFIG_NET=y
CONFIG_DM_ETH=y
CONFIG_PHYLIB=y
CONFIG_NETDEVICES=y
CONFIG_RTL9607DQ_ETH=y
CONFIG_CMD_NET=y
CONFIG_CMD_DHCP=y
CONFIG_CMD_PING=y
CONFIG_CMD_MII=y
CONFIG_CMD_TFTPBOOT=y
CONFIG_CMD_MEMTEST=y
CONFIG_SYS_ALT_MEMTEST=y
CONFIG_ENV_SIZE=0x1f000
CONFIG_ENV_IS_IN_UBI=y
CONFIG_ENV_REDUNDANT=y
CONFIG_ENV_UBI_PART="ubi_device"
CONFIG_ENV_UBI_VOLUME="ubootenv"
CONFIG_ENV_UBI_VOLUME_REDUND="ubootenv2"
CONFIG_BOOTCOUNT_LIMIT=y
CONFIG_BOOTCOUNT_ENV=y
CONFIG_WDT=y
CONFIG_WDT_RTL9607DQ=y
# CONFIG_WATCHDOG_AUTOSTART is not set
```

## target/linux/realtek-taurus/files-6.18/Documentation/devicetree/bindings/gpio/cortina,ca77xx-gpio.yaml
```yaml
# SPDX-License-Identifier: (GPL-2.0-only OR BSD-2-Clause)
%YAML 1.2
---
$id: http://devicetree.org/schemas/gpio/cortina,ca77xx-gpio.yaml#
$schema: http://devicetree.org/meta-schemas/core.yaml#

title: Cortina Access CA77xx GPIO controller

maintainers:
  - Ifran Ali <khanu.i.i.k.2000@gmail.com>

description:
  One GPIO group of the Cortina Access CA77xx / Realtek RTL9607DQ
  peripheral block, with up to 32 pins. An optional second register is
  the pin-mux word of the group, which the driver sets to GPIO for a pin
  when it is requested.

properties:
  compatible:
    const: cortina,ca77xx-gpio

  reg:
    minItems: 1
    items:
      - description: GPIO group registers
      - description: pin-mux word of the group

  gpio-controller: true

  "#gpio-cells":
    const: 2

  ngpios:
    minimum: 1
    maximum: 32

required:
  - compatible
  - reg
  - gpio-controller
  - "#gpio-cells"

additionalProperties: false

examples:
  - |
    bus {
        #address-cells = <2>;
        #size-cells = <2>;

        gpio@4f43292c0 {
            compatible = "cortina,ca77xx-gpio";
            reg = <0x4 0xf43292c0 0x0 0x24>,
                  <0x4 0xf4320100 0x0 0x4>;
            gpio-controller;
            #gpio-cells = <2>;
            ngpios = <16>;
        };
    };
```

## target/linux/realtek-taurus/files-6.18/Documentation/devicetree/bindings/net/realtek,rtl9607dq-ni.yaml
```yaml
# SPDX-License-Identifier: (GPL-2.0-only OR BSD-2-Clause)
%YAML 1.2
---
$id: http://devicetree.org/schemas/net/realtek,rtl9607dq-ni.yaml#
$schema: http://devicetree.org/meta-schemas/core.yaml#

title: Realtek RTL9607DQ network engine

maintainers:
  - Ifran Ali <khanu.i.i.k.2000@gmail.com>

description:
  The network interface (NI) of the Cortina Access / Realtek RTL9607DQ
  network engine. The NI is both the host Ethernet controller, described
  by the ethernet child node, and a switch whose ports are the internal
  GPHYs, an SGMII/HSGMII port and the CPU port.

properties:
  compatible:
    const: realtek,rtl9607dq-ni

  reg:
    items:
      - description: NI, L2/L3 forwarding engines and queue manager
      - description: LDMA (TX rings)
      - description: AXI reorder (RX DMA)
      - description: MDIO master
      - description: quad GPHY and SerDes analog
      - description: GPHY wrapper
      - description: SGMII/HSGMII PCS of the SerDes port
      - description: network engine SRAM (deep-queue packet buffers)

  reg-names:
    items:
      - const: ni
      - const: dma
      - const: reorder
      - const: mdio
      - const: gphy
      - const: gphy-wrap
      - const: pcs
      - const: sram

  interrupts:
    minItems: 8
    maxItems: 16
    description:
      The first eight are the per CPU port RX interrupts; the rest are
      further network engine interrupts the driver does not use.

  memory-region:
    items:
      - description: coherent DMA buffer pool
      - description: non-cached packet DMA pool

  realtek,glb:
    $ref: /schemas/types.yaml#/definitions/phandle
    description:
      Global configuration registers (syscon) with the network engine block
      resets and the SerDes mode selection.

  nvmem-cells:
    maxItems: 1
    description: MAC address of the host interface.

  nvmem-cell-names:
    const: mac-address

  mdio:
    $ref: mdio.yaml#
    unevaluatedProperties: false

  ethernet:
    type: object
    additionalProperties: false
    description:
      The host Ethernet controller, which the CPU port of the switch
      refers to.

  ports:
    type: object
    additionalProperties: false

    properties:
      "#address-cells":
        const: 1

      "#size-cells":
        const: 0

    patternProperties:
      "^port@[0-5]$":
        $ref: /schemas/net/dsa/dsa-port.yaml#
        unevaluatedProperties: false
        description:
          Switch ports 0 to 3 are the internal GPHYs, port 4 the SerDes
          port and port 5 the CPU port.

    required:
      - "#address-cells"
      - "#size-cells"

required:
  - compatible
  - reg
  - reg-names
  - interrupts
  - memory-region
  - realtek,glb
  - mdio
  - ethernet
  - ports

unevaluatedProperties: false

examples:
  - |
    #include <dt-bindings/interrupt-controller/arm-gic.h>

    ethernet@f4300000 {
        compatible = "realtek,rtl9607dq-ni";
        reg = <0xf4300000 0x10000>,
              <0xf7001000 0x1000>,
              <0xf432d000 0x20b8>,
              <0xf4329118 0x48>,
              <0xf4600000 0x100000>,
              <0xf4700000 0x100>,
              <0xf433a000 0x2000>,
              <0x80000000 0x3c000>;
        reg-names = "ni", "dma", "reorder", "mdio", "gphy", "gphy-wrap",
                    "pcs", "sram";
        interrupts = <GIC_SPI 84 IRQ_TYPE_LEVEL_HIGH>,
                     <GIC_SPI 85 IRQ_TYPE_LEVEL_HIGH>,
                     <GIC_SPI 86 IRQ_TYPE_LEVEL_HIGH>,
                     <GIC_SPI 87 IRQ_TYPE_LEVEL_HIGH>,
                     <GIC_SPI 88 IRQ_TYPE_LEVEL_HIGH>,
                     <GIC_SPI 89 IRQ_TYPE_LEVEL_HIGH>,
                     <GIC_SPI 90 IRQ_TYPE_LEVEL_HIGH>,
                     <GIC_SPI 91 IRQ_TYPE_LEVEL_HIGH>;
        memory-region = <&ne_cache>, <&ne_noncache>;
        realtek,glb = <&glb>;

        mdio {
            #address-cells = <1>;
            #size-cells = <0>;

            gphy0: ethernet-phy@1 {
                reg = <1>;
            };
        };

        gmac0: ethernet {
        };

        ports {
            #address-cells = <1>;
            #size-cells = <0>;

            port@0 {
                reg = <0>;
                label = "lan1";
                phy-mode = "internal";
                phy-handle = <&gphy0>;
            };

            port@5 {
                reg = <5>;
                ethernet = <&gmac0>;
                phy-mode = "internal";

                fixed-link {
                    speed = <1000>;
                    full-duplex;
                };
            };
        };
    };
```

## target/linux/realtek-taurus/files-6.18/Documentation/devicetree/bindings/net/realtek,rtl9607dq-pon.yaml
```yaml
# SPDX-License-Identifier: (GPL-2.0-only OR BSD-2-Clause)
%YAML 1.2
---
$id: http://devicetree.org/schemas/net/realtek,rtl9607dq-pon.yaml#
$schema: http://devicetree.org/meta-schemas/core.yaml#

title: Realtek RTL9607DQ PON MAC

maintainers:
  - Ifran Ali <khanu.i.i.k.2000@gmail.com>

description:
  The GPON/EPON MAC of the RTL9607DQ, driving the board's BOSA optical
  module. Only GPON is supported.

properties:
  compatible:
    const: realtek,rtl9607dq-pon

  reg:
    maxItems: 1

  interrupts:
    maxItems: 1

  nvmem-cells:
    minItems: 1
    items:
      - description: MAC address of the WAN interface
      - description: BOSA laser driver calibration image

  nvmem-cell-names:
    minItems: 1
    items:
      - const: mac-address
      - const: calibration

  tx-disable-gpios:
    maxItems: 1
    description: Laser transmit disable.

  tx-power-gpios:
    maxItems: 1
    description: Laser driver power enable.

required:
  - compatible
  - reg
  - interrupts

additionalProperties: false

examples:
  - |
    #include <dt-bindings/gpio/gpio.h>
    #include <dt-bindings/interrupt-controller/arm-gic.h>

    pon@f5500000 {
        compatible = "realtek,rtl9607dq-pon";
        reg = <0xf5500000 0xc000>;
        interrupts = <GIC_SPI 1 IRQ_TYPE_LEVEL_HIGH>;
        tx-disable-gpios = <&gpio3 1 GPIO_ACTIVE_HIGH>;
        tx-power-gpios = <&gpio3 0 GPIO_ACTIVE_LOW>;
    };
```

## target/linux/realtek-taurus/files-6.18/Documentation/devicetree/bindings/net/wireless/realtek,rtw89-pci.yaml
```yaml
# SPDX-License-Identifier: (GPL-2.0-only OR BSD-2-Clause)
%YAML 1.2
---
$id: http://devicetree.org/schemas/net/wireless/realtek,rtw89-pci.yaml#
$schema: http://devicetree.org/meta-schemas/core.yaml#

title: Realtek rtw89 wireless devices (PCIe)

maintainers:
  - Ifran Ali <khanu.i.i.k.2000@gmail.com>

description:
  Realtek IEEE 802.11ax PCIe devices handled by the rtw89 driver. The node
  describes a device soldered to the board. On boards that leave the efuse
  of the device blank, the values the efuse would hold are given here.

allOf:
  - $ref: ieee80211.yaml#

properties:
  compatible:
    enum:
      - pci10ec,0192  # RTL8192XB
      - pci10ec,c852  # RTL8852C

  reg:
    maxItems: 1

  nvmem-cells:
    maxItems: 1
    description: Cell holding the MAC address of the device.

  nvmem-cell-names:
    const: mac-address

  realtek,rfe-type:
    $ref: /schemas/types.yaml#/definitions/uint32
    maximum: 254
    description:
      RF front-end type of the board, selecting the BB, RF and TX power
      tables. Types above 50 use an external front-end module.

  realtek,xtal-cap:
    $ref: /schemas/types.yaml#/definitions/uint32
    maximum: 127
    description: Crystal load capacitor trim of the board.

  '#cooling-cells':
    const: 2
    description:
      The device throttles its TX airtime as a thermal cooling device.

  '#thermal-sensor-cells':
    const: 0
    description:
      The device reports its temperature as a thermal sensor.

required:
  - compatible
  - reg

unevaluatedProperties: false

examples:
  - |
    pcie {
        #address-cells = <3>;
        #size-cells = <2>;

        pcie@0,0 {
            reg = <0x0000 0 0 0 0>;
            #address-cells = <3>;
            #size-cells = <2>;
            device_type = "pci";
            ranges;

            wifi@0,0 {
                compatible = "pci10ec,c852";
                reg = <0x0000 0 0 0 0>;
                #cooling-cells = <2>;
                #thermal-sensor-cells = <0>;
                ieee80211-freq-limit = <5170000 5835000>;
                realtek,rfe-type = <54>;
                realtek,xtal-cap = <63>;
            };
        };
    };
```
