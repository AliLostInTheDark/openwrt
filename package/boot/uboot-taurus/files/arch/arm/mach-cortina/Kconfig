## target/linux/realtek-taurus/files-6.18/Documentation/devicetree/bindings/pci/realtek,rtl9607dq-pcie.yaml
```yaml
# SPDX-License-Identifier: (GPL-2.0-only OR BSD-2-Clause)
%YAML 1.2
---
$id: http://devicetree.org/schemas/pci/realtek,rtl9607dq-pcie.yaml#
$schema: http://devicetree.org/meta-schemas/core.yaml#

title: Realtek RTL9607DQ PCIe host controller

maintainers:
  - Ifran Ali <khanu.i.i.k.2000@gmail.com>

description:
  DesignWare PCIe root complex of the Realtek RTL9607DQ, one per SerDes
  lane, with a Cortina glue block that carries INTx and MSI on one
  interrupt line.

allOf:
  - $ref: /schemas/pci/pci-host-bridge.yaml#

properties:
  compatible:
    const: realtek,rtl9607dq-pcie

  reg:
    items:
      - description: glue registers (resets, interrupts, link status)
      - description: DesignWare DBI registers
      - description: configuration space window
      - description: iATU registers
      - description: SerDes PHY registers

  reg-names:
    items:
      - const: glbl_regs
      - const: rc_dbi
      - const: config
      - const: iatu
      - const: serdes_phy

  interrupts:
    minItems: 1
    items:
      - description: glue interrupt carrying INTx and MSI
      - description: controller interrupt line 1, unused
      - description: controller interrupt line 2, unused
      - description: controller interrupt line 3, unused

  realtek,glb:
    $ref: /schemas/types.yaml#/definitions/phandle
    description: The GLB syscon holding the PCIe block and SerDes resets.

  realtek,serdes-cfg:
    $ref: /schemas/types.yaml#/definitions/uint32-matrix
    description:
      SerDes PHY register writes applied before link training, as
      <offset value> pairs relative to the serdes_phy registers.
    items:
      items:
        - description: register offset
        - description: value

  num-lanes:
    const: 1

  num-viewport:
    $ref: /schemas/types.yaml#/definitions/uint32
    description: Number of iATU viewports.

  reset-gpios:
    maxItems: 1
    description: PERST# of the device behind the port.

  interrupt-controller:
    type: object
    additionalProperties: false
    description: INTx interrupt controller of the glue block.

    properties:
      interrupt-controller: true

      "#address-cells":
        const: 0

      "#interrupt-cells":
        const: 1

    required:
      - interrupt-controller
      - "#address-cells"
      - "#interrupt-cells"

required:
  - compatible
  - reg
  - reg-names
  - interrupts
  - realtek,glb
  - realtek,serdes-cfg
  - reset-gpios
  - interrupt-controller

unevaluatedProperties: false

examples:
  - |
    #include <dt-bindings/gpio/gpio.h>
    #include <dt-bindings/interrupt-controller/arm-gic.h>

    bus {
        #address-cells = <2>;
        #size-cells = <2>;

        pcie@f4325000 {
            compatible = "realtek,rtl9607dq-pcie";
            reg = <0x0 0xf4325000 0x0 0x400>,
                  <0x0 0xa0000000 0x0 0x1000>,
                  <0x0 0xa0001000 0x0 0x2000>,
                  <0x0 0xa0300000 0x0 0x100000>,
                  <0x0 0xf4333000 0x0 0x2000>;
            reg-names = "glbl_regs", "rc_dbi", "config", "iatu", "serdes_phy";
            realtek,glb = <&glb>;
            #address-cells = <3>;
            #size-cells = <2>;
            device_type = "pci";
            bus-range = <0x00 0xff>;
            ranges = <0x81000000 0x0 0x00000000 0x0 0xa0003000 0x0 0x00010000>,
                     <0x82000000 0x0 0xa0400000 0x0 0xa0400000 0x0 0x0fc00000>;
            num-viewport = <1>;
            num-lanes = <1>;
            interrupts = <GIC_SPI 42 IRQ_TYPE_LEVEL_HIGH>;
            #interrupt-cells = <1>;
            interrupt-map-mask = <0 0 0 7>;
            interrupt-map = <0 0 0 1 &pcie0_intc 0>,
                            <0 0 0 2 &pcie0_intc 1>,
                            <0 0 0 3 &pcie0_intc 2>,
                            <0 0 0 4 &pcie0_intc 3>;
            realtek,serdes-cfg = <0x004 0xa855>, <0x008 0x60c6>;
            reset-gpios = <&gpio3 5 GPIO_ACTIVE_LOW>;

            pcie0_intc: interrupt-controller {
                interrupt-controller;
                #address-cells = <0>;
                #interrupt-cells = <1>;
            };
        };
    };
```

## target/linux/realtek-taurus/files-6.18/Documentation/devicetree/bindings/phy/realtek,rtl9607dq-usb-phy.yaml
```yaml
# SPDX-License-Identifier: (GPL-2.0-only OR BSD-2-Clause)
%YAML 1.2
---
$id: http://devicetree.org/schemas/phy/realtek,rtl9607dq-usb-phy.yaml#
$schema: http://devicetree.org/meta-schemas/core.yaml#

title: Realtek RTL9607DQ USB 2.0 and USB 3.0 PHY

maintainers:
  - Ifran Ali <khanu.i.i.k.2000@gmail.com>

description:
  The USB PHYs of the RTL9607DQ's DWC3 controller. Cell 0 is the USB 2.0
  PHY, cell 1 the USB 3.0 PHY on SerDes S2.

properties:
  compatible:
    const: realtek,rtl9607dq-usb-phy

  reg:
    items:
      - description: USB host configuration and PHY access registers
      - description: SerDes S2 registers

  reg-names:
    items:
      - const: usbcfg
      - const: serdes

  realtek,glb:
    $ref: /schemas/types.yaml#/definitions/phandle
    description: The GLB syscon holding the USB and SerDes resets.

  "#phy-cells":
    const: 1

  vbus-supply:
    description: Regulator switching the USB VBUS of the host ports.

required:
  - compatible
  - reg
  - reg-names
  - realtek,glb
  - "#phy-cells"

additionalProperties: false

examples:
  - |
    usb-phy@f432b000 {
        compatible = "realtek,rtl9607dq-usb-phy";
        reg = <0xf432b000 0x60>,
              <0xf4337000 0x1000>;
        reg-names = "usbcfg", "serdes";
        realtek,glb = <&glb>;
        #phy-cells = <1>;
    };
```

## target/linux/realtek-taurus/files-6.18/Documentation/devicetree/bindings/serial/cortina,serial.yaml
```yaml
# SPDX-License-Identifier: (GPL-2.0-only OR BSD-2-Clause)
%YAML 1.2
---
$id: http://devicetree.org/schemas/serial/cortina,serial.yaml#
$schema: http://devicetree.org/meta-schemas/core.yaml#

title: Cortina Access UART

maintainers:
  - Ifran Ali <khanu.i.i.k.2000@gmail.com>

allOf:
  - $ref: serial.yaml#

properties:
  compatible:
    const: cortina,serial

  reg:
    maxItems: 1

  interrupts:
    maxItems: 1

  clocks:
    maxItems: 1

  clock-frequency:
    description: UART input clock, used when no clock is given.

required:
  - compatible
  - reg
  - interrupts

unevaluatedProperties: false

examples:
  - |
    #include <dt-bindings/interrupt-controller/arm-gic.h>

    serial@f43291b0 {
        compatible = "cortina,serial";
        reg = <0xf43291b0 0x30>;
        interrupts = <GIC_SPI 4 IRQ_TYPE_LEVEL_HIGH>;
        clock-frequency = <125000000>;
    };
```

## target/linux/realtek-taurus/files-6.18/Documentation/devicetree/bindings/soc/realtek/realtek,rtl9607dq-glb.yaml
```yaml
# SPDX-License-Identifier: (GPL-2.0-only OR BSD-2-Clause)
%YAML 1.2
---
$id: http://devicetree.org/schemas/soc/realtek/realtek,rtl9607dq-glb.yaml#
$schema: http://devicetree.org/meta-schemas/core.yaml#

title: Realtek RTL9607DQ global configuration registers

maintainers:
  - Ifran Ali <khanu.i.i.k.2000@gmail.com>

description:
  The GLB block holds the block resets, CPU PLL and divider controls, PHY and
  SerDes selection and status, and other chip-wide configuration shared by the
  CPU clock, PCIe, USB and network drivers.

properties:
  compatible:
    items:
      - const: realtek,rtl9607dq-glb
      - const: syscon

  reg:
    maxItems: 1

  clocks:
    maxItems: 1
    description: 25 MHz crystal reference clock feeding the CPU PLL.

  "#clock-cells":
    const: 0

required:
  - compatible
  - reg
  - clocks
  - "#clock-cells"

additionalProperties: false

examples:
  - |
    syscon@f4320000 {
        compatible = "realtek,rtl9607dq-glb", "syscon";
        reg = <0xf4320000 0x400>;
        clocks = <&refclk>;
        #clock-cells = <0>;
    };
```

## target/linux/realtek-taurus/files-6.18/Documentation/devicetree/bindings/sound/realtek,rtl9607dq-ssp.yaml
```yaml
# SPDX-License-Identifier: (GPL-2.0-only OR BSD-2-Clause)
%YAML 1.2
---
$id: http://devicetree.org/schemas/sound/realtek,rtl9607dq-ssp.yaml#
$schema: http://devicetree.org/meta-schemas/core.yaml#

title: Realtek RTL9607DQ SSP PCM/TDM controller

maintainers:
  - Ifran Ali <khanu.i.i.k.2000@gmail.com>

description:
  The voice PCM interface of the RTL9607DQ. It clocks a TDM frame of up to
  32 slots of 8 bits at 8 kHz and moves the valid slots through a DMA queue
  pair of the DMA_SEC block, which it shares with the network engine.

allOf:
  - $ref: dai-common.yaml#

properties:
  compatible:
    const: realtek,rtl9607dq-ssp

  reg:
    items:
      - description: SSP controller
      - description: SSP DMA global control
      - description: SSP DMA queue pair
      - description: SSP DMA interrupt status and enable

  reg-names:
    items:
      - const: ssp
      - const: dma
      - const: queue
      - const: irq

  interrupts:
    items:
      - description: playback DMA
      - description: capture DMA

  interrupt-names:
    items:
      - const: tx
      - const: rx

  "#sound-dai-cells":
    const: 0

required:
  - compatible
  - reg
  - reg-names
  - interrupts
  - "#sound-dai-cells"

unevaluatedProperties: false

examples:
  - |
    #include <dt-bindings/interrupt-controller/arm-gic.h>

    pcm@f7001b80 {
        compatible = "realtek,rtl9607dq-ssp";
        reg = <0xf7001b80 0x80>, <0xf7001064 0x54>,
              <0xf7001a80 0x80>, <0xf7001e08 0x8>;
        reg-names = "ssp", "dma", "queue", "irq";
        interrupts = <GIC_SPI 17 IRQ_TYPE_LEVEL_HIGH>,
                     <GIC_SPI 18 IRQ_TYPE_LEVEL_HIGH>;
        interrupt-names = "tx", "rx";
        #sound-dai-cells = <0>;
    };
```

## target/linux/realtek-taurus/files-6.18/Documentation/devicetree/bindings/spi/cortina,ca-qspi.yaml
```yaml
# SPDX-License-Identifier: (GPL-2.0-only OR BSD-2-Clause)
%YAML 1.2
---
$id: http://devicetree.org/schemas/spi/cortina,ca-qspi.yaml#
$schema: http://devicetree.org/meta-schemas/core.yaml#

title: Cortina Access quad SPI flash controller

maintainers:
  - Ifran Ali <khanu.i.i.k.2000@gmail.com>

description:
  The serial flash controller of Cortina Access CA77xx / Realtek RTL9607DQ
  SoCs, used here with one SPI-NAND chip.

allOf:
  - $ref: spi-controller.yaml#

properties:
  compatible:
    const: cortina,ca-qspi

  reg:
    maxItems: 1

  reg-names:
    const: qspi-base

required:
  - compatible
  - reg
  - reg-names

unevaluatedProperties: false

examples:
  - |
    bus {
        #address-cells = <2>;
        #size-cells = <2>;

        spi@4f4324000 {
            compatible = "cortina,ca-qspi";
            reg = <0x4 0xf4324000 0x0 0x50>;
            reg-names = "qspi-base";
            #address-cells = <1>;
            #size-cells = <0>;

            flash@0 {
                compatible = "spi-nand";
                reg = <0>;
            };
        };
    };
```

## target/linux/realtek-taurus/files-6.18/Documentation/devicetree/bindings/spi/realtek,rtl9607dq-per-spi.yaml
```yaml
# SPDX-License-Identifier: (GPL-2.0-only OR BSD-2-Clause)
%YAML 1.2
---
$id: http://devicetree.org/schemas/spi/realtek,rtl9607dq-per-spi.yaml#
$schema: http://devicetree.org/meta-schemas/core.yaml#

title: Realtek RTL9607DQ peripheral SPI controller

maintainers:
  - Ifran Ali <khanu.i.i.k.2000@gmail.com>

description:
  The SPI controller in the peripheral block of the RTL9607DQ. It moves up to
  12 bytes per hardware access with the chip select asserted for that access
  only. Boards use it for SLICs and similar low-rate devices.

allOf:
  - $ref: spi-controller.yaml#

properties:
  compatible:
    const: realtek,rtl9607dq-per-spi

  reg:
    maxItems: 1

  interrupts:
    maxItems: 1

  clocks:
    maxItems: 1

required:
  - compatible
  - reg
  - clocks

unevaluatedProperties: false

examples:
  - |
    spi@f43290d8 {
        compatible = "realtek,rtl9607dq-per-spi";
        reg = <0xf43290d8 0x40>;
        clocks = <&pclk>;
        #address-cells = <1>;
        #size-cells = <0>;

        slic@0 {
            compatible = "maxlinear,pef32001";
            reg = <0>;
            spi-max-frequency = <2500000>;
            spi-cpol;
            spi-cpha;
        };
    };
```

## target/linux/realtek-taurus/files-6.18/Documentation/devicetree/bindings/thermal/realtek,rtl9607dq-thermal.yaml
```yaml
# SPDX-License-Identifier: (GPL-2.0-only OR BSD-2-Clause)
%YAML 1.2
---
$id: http://devicetree.org/schemas/thermal/realtek,rtl9607dq-thermal.yaml#
$schema: http://devicetree.org/meta-schemas/core.yaml#

title: Realtek RTL9607DQ on-die temperature sensor

maintainers:
  - Ifran Ali <khanu.i.i.k.2000@gmail.com>

allOf:
  - $ref: thermal-sensor.yaml#

properties:
  compatible:
    const: realtek,rtl9607dq-thermal

  reg:
    maxItems: 1

  "#thermal-sensor-cells":
    const: 0

required:
  - compatible
  - reg

unevaluatedProperties: false

examples:
  - |
    thermal-sensor@f4320264 {
        compatible = "realtek,rtl9607dq-thermal";
        reg = <0xf4320264 0x10>;
        #thermal-sensor-cells = <0>;
    };
```

## target/linux/realtek-taurus/files-6.18/Documentation/devicetree/bindings/watchdog/realtek,rtl9607dq-wdt.yaml
```yaml
# SPDX-License-Identifier: (GPL-2.0-only OR BSD-2-Clause)
%YAML 1.2
---
$id: http://devicetree.org/schemas/watchdog/realtek,rtl9607dq-wdt.yaml#
$schema: http://devicetree.org/meta-schemas/core.yaml#

title: Realtek RTL9607DQ watchdog

maintainers:
  - Ifran Ali <khanu.i.i.k.2000@gmail.com>

description:
  Watchdog timer of the Realtek RTL9607DQ (Cortina Access) SoC. The counter
  runs from the peripheral clock and resets the SoC when it expires.

allOf:
  - $ref: watchdog.yaml#

properties:
  compatible:
    const: realtek,rtl9607dq-wdt

  reg:
    maxItems: 1

  clocks:
    maxItems: 1

required:
  - compatible
  - reg
  - clocks

unevaluatedProperties: false

examples:
  - |
    watchdog@f432901c {
        compatible = "realtek,rtl9607dq-wdt";
        reg = <0xf432901c 0x30>;
        clocks = <&pclk>;
    };
```

## target/linux/realtek-taurus/files-6.18/sound/soc/realtek/Kconfig
```kconfig
# SPDX-License-Identifier: GPL-2.0-only
menu "Realtek"

config SND_SOC_RTL9607DQ_SSP
	tristate "Realtek RTL9607DQ SSP PCM/TDM support"
	depends on OF && HAS_IOMEM && HAS_DMA
	help
	  Say Y or M here to enable the PCM/TDM interface (SSP) of the
	  Realtek RTL9607DQ SoC, which carries the voice samples of an FXS
	  SLIC.

endmenu
```
